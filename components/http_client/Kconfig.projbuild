## components/http_client/Kconfig.projbuild
```kconfig
menu "Configuración de HTTP POST"

	config HTTP_POST_URL
		string "URL del servidor HTTP POST"
		default "http://example.com/post"
		help
			Especifica la URL del servidor al que se enviarán los datos.
	
	config HTTP_POST_TIMEOUT
		int "Tiempo de espera en milisegundos"
		range 3000 10000
		default 3000
		help
			Define el tiempo máximo de espera en milisegundos para la respuesta del servidor HTTP POST.
	
endmenu
	
```

## components/tasks/Kconfig.projbuild
```kconfig
menu "Configuración TASK HTTP POST"

	config HTTP_POST_RETRIES
		int "Número de reintentos en caso de fallo"
		default 1
		help
			Define cuántos intentos de reenvío se harán si la solicitud HTTP POST falla.

	config HTTP_POST_RETRY_DELAY
		int "Tiempo de espera entre reintentos (ms)"
		range 500 10000
		default 2000
		help
			Tiempo en milisegundos que se espera entre cada intento fallido de HTTP POST.
				
endmenu
```

## components/wifi_manager/Kconfig.projbuild
```kconfig
menu "Wi-Fi Configuration"

    config WIFI_SSID
        string "Wi-Fi SSID"
        default "MiRedWiFi"
        help
            Nombre de la red Wi-Fi a la que se conectará el ESP32.
    
    config WIFI_PASSWORD
        string "Wi-Fi Password"
        default "MiClaveSecreta"
        help
            Contraseña de la red Wi-Fi.
    
    endmenu
    
```

## sdkconfig.defaults
```kconfig
CONFIG_HTTP_POST_URL="http://example.com/api"
CONFIG_HTTP_POST_TIMEOUT=5000
CONFIG_HTTP_POST_RETRIES=3
CONFIG_HTTP_POST_RETRY_DELAY=2000
```
